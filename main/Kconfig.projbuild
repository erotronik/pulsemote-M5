## main/Kconfig.projbuild
```kconfig
menu "Pulsemote Board selection"

choice BOARD
    prompt "Target board"
    default BOARD_M5TAB5
help
    Select the board this firmware is built for.

config BOARD_M5TAB5
    bool "M5TAB5"

config BOARD_M5CORES3
    bool "M5CoreS3"

endchoice

config PULSEMOTE_PCB
    bool "PulseMote PCB variant"
    default y if BOARD_M5CORES3
    help
        If you have the Pulsemote-M5 PCB attached

config HASM5ENCODER
    bool "Has an M5Stack Unit 8Encoder on Port A"
    depends on BOARD_M5TAB5
    default y
    help
        Use an M5Stack Unit 8Encoder plugged into the Tab5's Port A, if there is one

config HASWIFICOPRO
    bool "Has a espat coprocessor for wifi"
    default y if BOARD_M5CORESS3
    help
        If you have a esp32c6 connected for wifi via esp-at

endmenu
```

## src/Kconfig.projbuild
```kconfig
menu "Pulsemote Board selection"

choice BOARD
    prompt "Target board"
    default BOARD_M5TAB5
help
    Select the board this firmware is built for.

config BOARD_M5TAB5
    bool "M5TAB5"

config BOARD_M5CORES3
    bool "M5CoreS3"

endchoice

config PULSEMOTE_PCB
    bool "PulseMote PCB variant"
    default y if BOARD_M5CORES3
    help
        If you have the Pulsemote-M5 PCB attached

endmenu
```
